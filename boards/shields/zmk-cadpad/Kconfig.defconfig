## boards/shields/zmk-cadpad/Kconfig.defconfig
```kconfig
if SHIELD_ZMK-CADPAD

# Name must be less than 16 characters long!
config ZMK_KEYBOARD_NAME
    default "CADPAD"

endif
```

## boards/shields/zmk-cadpad/Kconfig.shield
```kconfig
# No whitespace after the comma or in your keyboard name!
config SHIELD_ZMK-CADPAD
    def_bool $(shields_list_contains,zmk-cadpad)
```
